#pragma once
// --- A REAL EPUB, ASSEMBLED IN MEMORY, FOR TESTS THAT NEED ONE SHAPED A PARTICULAR
// --- WAY.
//
// The zip half of this was cardfix::buildZip in card_book_fixture.h until a second
// caller wanted it, which is this project's own extraction point. It is here rather
// than there because card_book_fixture.h drags in ReaderScreen, a theme and a type
// ramp to build a CardReading, and test_book.cpp wants none of those -- it tests the
// layer that turns a file into offsets.
//
// NOT IN test/unit/epub_fixtures.h, and that decision is inherited rather than new:
// that header is GENERATED by tools/mkzip.py and says so at the top, so a
// hand-written fixture in it would be erased by the next regeneration. It also could
// not serve withCoverImage(), which takes its bytes at RUN time -- a generated
// constant array cannot.
//
// The one thing that makes assembling an EPUB here cheap is that DEFLATE has a
// STORED BLOCK MODE -- BFINAL/BTYPE=00, a 5-byte header and the bytes -- so a valid
// method-8 entry needs no compressor, only a framer. inflate_stream.cpp validates
// the NLEN complement, so a mis-framed block fails loudly rather than silently.
#include <cstdint>
#include <string>
#include <string_view>
#include <vector>

namespace epubbuild {

inline void put16(std::string& s, uint16_t v) {
  s += static_cast<char>(v & 0xFF);
  s += static_cast<char>((v >> 8) & 0xFF);
}
inline void put32(std::string& s, uint32_t v) {
  for (int i = 0; i < 4; ++i) s += static_cast<char>((v >> (8 * i)) & 0xFF);
}

// Raw DEFLATE (no zlib wrapper -- the zip's csize/usize carry the framing) made
// entirely of stored blocks. Valid DEFLATE that any inflater must accept.
inline std::string storedDeflate(const std::string& data) {
  std::string out;
  size_t at = 0;
  do {
    const size_t n = data.size() - at > 65535 ? 65535 : data.size() - at;
    const bool last = at + n >= data.size();
    out += static_cast<char>(last ? 1 : 0);  // BFINAL, BTYPE=00, then byte-aligned
    put16(out, static_cast<uint16_t>(n));
    put16(out, static_cast<uint16_t>(~static_cast<uint16_t>(n)));
    out.append(data, at, n);
    at += n;
  } while (at < data.size());
  return out;
}

struct ZipEntry {
  std::string name;
  std::string data;
  bool deflate = true;
};

// zip.cpp trusts the CENTRAL directory and validates no CRC, so the field is zero.
inline std::string buildZip(const std::vector<ZipEntry>& entries) {
  std::string out, central;
  for (const ZipEntry& e : entries) {
    const std::string raw = e.deflate ? storedDeflate(e.data) : e.data;
    const uint32_t off = static_cast<uint32_t>(out.size());
    put32(out, 0x04034B50);
    put16(out, 20);
    put16(out, 0);
    put16(out, e.deflate ? 8 : 0);
    put16(out, 0);
    put16(out, 0);
    put32(out, 0);  // crc32 -- not validated, see above
    put32(out, static_cast<uint32_t>(raw.size()));
    put32(out, static_cast<uint32_t>(e.data.size()));
    put16(out, static_cast<uint16_t>(e.name.size()));
    put16(out, 0);
    out += e.name;
    out += raw;

    put32(central, 0x02014B50);
    put16(central, 20);
    put16(central, 20);
    put16(central, 0);
    put16(central, e.deflate ? 8 : 0);
    put16(central, 0);
    put16(central, 0);
    put32(central, 0);
    put32(central, static_cast<uint32_t>(raw.size()));
    put32(central, static_cast<uint32_t>(e.data.size()));
    put16(central, static_cast<uint16_t>(e.name.size()));
    put16(central, 0);
    put16(central, 0);
    put16(central, 0);
    put16(central, 0);
    put32(central, 0);
    put32(central, off);
    central += e.name;
  }
  const uint32_t cdOff = static_cast<uint32_t>(out.size());
  out += central;
  put32(out, 0x06054B50);
  put16(out, 0);
  put16(out, 0);
  put16(out, static_cast<uint16_t>(entries.size()));
  put16(out, static_cast<uint16_t>(entries.size()));
  put32(out, static_cast<uint32_t>(central.size()));
  put32(out, cdOff);
  put16(out, 0);
  return out;
}

// --- COVER FIXTURES -----------------------------------------------------------
//
// Every cover book below is the SAME two-chapter book with one image added, so a
// difference between two of them is the OPF route and nothing else.
//
// THE COVER LIVES IN A SUBDIRECTORY (`OEBPS/images/cover.jpg`) ON PURPOSE. An OPF's
// href is relative to the OPF's own directory, so a cover at `OEBPS/cover.jpg` would
// resolve correctly even for an implementation that ignored the base entirely --
// which is the bug resolveHref exists to catch, and a fixture that cannot fail it is
// not testing it.
//
// AND IT IS STORED, method 0, as a real EPUB's JPEG is: an already-compressed image
// gains nothing from DEFLATE, and storing it here means `deflated == false` reaches
// the span rather than being a value no fixture ever produces.
inline constexpr std::string_view kCoverEntry = "OEBPS/images/cover.jpg";

// Not a JPEG. The fixtures that use it are about WHERE the cover is, and nothing on
// this path decodes it -- withCoverImage() is for a caller with real bytes.
inline constexpr std::string_view kFakeCoverBytes =
    "not really a jpeg, but bytes all the same";

namespace detail {

// `metaExtra` goes inside <metadata>, `itemExtra` inside <manifest>. Everything else
// is one book, so the fixtures differ only where they mean to.
inline std::string assemble(const std::string& metaExtra, const std::string& itemExtra,
                            std::string_view coverBytes, bool withCoverEntry,
                            bool deflateCover = false,
                            const std::vector<ZipEntry>& extraEntries = {}) {
  const std::string container =
      "<?xml version=\"1.0\"?>"
      "<container version=\"1.0\" "
      "xmlns=\"urn:oasis:names:tc:opendocument:xmlns:container\">"
      "<rootfiles><rootfile full-path=\"OEBPS/content.opf\" "
      "media-type=\"application/oebps-package+xml\"/></rootfiles></container>";
  const std::string opf =
      "<?xml version=\"1.0\"?>"
      "<package xmlns=\"http://www.idpf.org/2007/opf\" version=\"3.0\" "
      "unique-identifier=\"bookid\">"
      "<metadata xmlns:dc=\"http://purl.org/dc/elements/1.1/\">"
      "<dc:identifier id=\"bookid\">urn:uuid:0000-1111</dc:identifier>"
      "<dc:title>Middlemarch</dc:title><dc:creator>George Eliot</dc:creator>"
      "<dc:language>en</dc:language>" +
      metaExtra +
      "</metadata>"
      "<manifest>"
      "<item id=\"ch1\" href=\"ch1.xhtml\" media-type=\"application/xhtml+xml\"/>"
      "<item id=\"ch2\" href=\"ch2.xhtml\" media-type=\"application/xhtml+xml\"/>" +
      itemExtra +
      "</manifest>"
      "<spine><itemref idref=\"ch1\"/><itemref idref=\"ch2\"/></spine></package>";

  std::vector<ZipEntry> entries = {
      {"mimetype", "application/epub+zip", false},
      {"META-INF/container.xml", container, true},
      {"OEBPS/content.opf", opf, true},
      {"OEBPS/ch1.xhtml", "<html><body><p>One.</p></body></html>", true},
      {"OEBPS/ch2.xhtml", "<html><body><p>Two.</p></body></html>", true},
  };
  if (withCoverEntry)
    entries.push_back({std::string(kCoverEntry), std::string(coverBytes), deflateCover});
  for (const ZipEntry& e : extraEntries) entries.push_back(e);
  return buildZip(entries);
}

// The manifest item every cover route names. `props` is written out verbatim when
// non-empty, so a caller can state a whole space-separated list.
inline std::string coverItem(const std::string& props) {
  std::string s =
      "<item id=\"cover-img\" href=\"images/cover.jpg\" media-type=\"image/jpeg\"";
  if (!props.empty()) s += " properties=\"" + props + "\"";
  return s + "/>";
}

}  // namespace detail

// A book that declares no cover at all. 225 of 225 corpus books declare one, so this
// is not a shape found in the wild -- it is the shape the firmware must not refuse.
inline std::string minimalEpub() { return detail::assemble("", "", "", false); }

// ROUTE 1: `<meta name="cover" content="id">`, the EPUB 2 convention. Not in any
// spec, and overwhelmingly the one the corpus uses.
inline std::string withCoverMetaTag() {
  return detail::assemble("<meta name=\"cover\" content=\"cover-img\"/>",
                          detail::coverItem(""), kFakeCoverBytes, true);
}

// ROUTE 2: EPUB 3's `properties="cover-image"`. The list is deliberately TWO tokens
// with the interesting one SECOND -- `properties` is a space-separated set, so a
// fixture stating it alone cannot tell a token walk from a string compare.
inline std::string withCoverProperties() {
  return detail::assemble("", detail::coverItem("svg cover-image"), kFakeCoverBytes,
                          true);
}

// The same list separated by a NEWLINE rather than a space. An XML attribute value
// may hold any of the four whitespace characters, and xml.cpp copies attribute bytes
// raw -- it does no attribute-value normalisation -- so a tokenizer that split on
// ' ' alone would see one token, `svg\ncover-image`, and declare no cover.
//
// It exists because narrowing hasToken's whitespace set to space-only failed ZERO
// assertions while every other cover fixture used a plain space.
inline std::string withCoverPropertiesNewlineSeparated() {
  return detail::assemble("", detail::coverItem("svg\ncover-image"), kFakeCoverBytes,
                          true);
}

// A book whose only `cover-image` is a SUBSTRING of some other property. This is the
// fixture that makes the token walk load-bearing: a `find()` matches it, and the book
// declares no cover at all.
inline std::string withCoverPropertiesLookalike() {
  return detail::assemble("", detail::coverItem("not-cover-image"), kFakeCoverBytes,
                          true);
}

// BOTH ROUTES, DISAGREEING. Real books carry this: `<meta name="cover">` pointing at
// the cover PAGE while `properties="cover-image"` sits on the image. Without a
// fixture where the two name different entries, "the manifest's declaration wins" is
// a claim in a comment that no test can reach.
//
// The decoy is a real archive entry and DEFLATED, where the image is stored -- so the
// storage method alone says which route won, and a wrong answer cannot hide behind
// an entry that happens to be missing.
inline std::string withBothCoverRoutesDisagreeing() {
  return detail::assemble(
      "<meta name=\"cover\" content=\"cover-page\"/>",
      "<item id=\"cover-page\" href=\"ch2.xhtml\" media-type=\"application/xhtml+xml\"/>" +
          detail::coverItem("cover-image"),
      kFakeCoverBytes, true);
}

// EVERY FIELD Epub NOTES DURING THE OPF WALK, all three at once: an NCX, a
// stylesheet and a cover. Its opposite number is minimalEpub(), which declares none
// of them -- the pair is what proves open() RESETS rather than accumulates.
//
// The NCX and the CSS are manifest-only, with no archive entry, and that is correct
// rather than lazy: Epub::open validates the SPINE against the archive and nothing
// else, so it notes both paths without reading either. Whoever reads them later
// (loadToc, collectItalicClasses) opens the archive itself.
inline std::string withEverythingNoted() {
  return detail::assemble(
      "<meta name=\"cover\" content=\"cover-img\"/>",
      "<item id=\"ncx\" href=\"toc.ncx\" media-type=\"application/x-dtbncx+xml\"/>"
      "<item id=\"css\" href=\"style.css\" media-type=\"text/css\"/>" +
          detail::coverItem(""),
      kFakeCoverBytes, true);
}

// A STYLESHEET THAT IS REALLY IN THE ARCHIVE, deflated, declaring one italic class.
//
// Every other fixture here notes its CSS in the manifest and leaves the entry out,
// which is right for what they test (Epub::open validates the spine and nothing
// else) and means nothing in the suite ever reached the code that READS a stylesheet
// off the card. A mutation removing readEntry's growth guard passed all 1,403 cases
// against a fixture with no stylesheet at all -- a mutation telling you about your
// input before it tells you about your test.
// PADDED PAST 2 KB, so the sheet's own growth is the LARGEST thing the open path
// allocates and a test can therefore refuse it alone. At 29 bytes it was the
// smallest, and no ceiling could single it out.
inline std::string withRealStylesheet() {
  std::string sheet = ".ital { font-style: italic; }\n/*";
  sheet.append(4096, 'x');
  sheet += "*/\n";
  const std::vector<ZipEntry> extra = {{"OEBPS/style.css", sheet, true}};
  return detail::assemble("",
                          "<item id=\"css\" href=\"style.css\" media-type=\"text/css\"/>", "",
                          false, false, extra);
}

// A manifest that DECLARES a cover the archive does not hold. Every other fixture
// here has both halves, so without this the "a missing cover entry is not a refusal"
// clause in book.cpp is a claim no test can reach -- a mutation making it a refusal
// failed nothing, which is what put this fixture here.
inline std::string withCoverDeclaredButAbsent() {
  return detail::assemble("<meta name=\"cover\" content=\"cover-img\"/>",
                          detail::coverItem(""), "", false);
}

// `<meta name="cover">` naming an id no manifest item carries. Real OPFs get this
// wrong the same way they get `unique-identifier` wrong, and the same call applies:
// a cross-reference inside the OPF that does not resolve costs the book the thing it
// named and nothing else.
inline std::string withCoverIdUnresolved() {
  return detail::assemble("<meta name=\"cover\" content=\"no-such-item\"/>", "", "",
                          false);
}

// The same book carrying REAL image bytes, stored, declared the EPUB 2 way. For a
// caller that is going to decode what comes back.
inline std::string withCoverImage(const std::string& bytes) {
  return detail::assemble("<meta name=\"cover\" content=\"cover-img\"/>",
                          detail::coverItem(""), bytes, true);
}

// THE SAME BOOK WITH THE COVER DEFLATED, method 8, which is the MAJORITY CASE FOR
// JPEG: 59% of the corpus's JPEG covers are compressed inside the zip, against 38
// of 39 PNGs stored. So the stored fixture above is the common shape for one
// format and the rare one for the other, and a decoder driven only through it
// would never once put the zip's inflater under the image decoder -- which is the
// path that holds TWO windows on device and the only one that can run out of
// memory.
//
// The entry is stored-block DEFLATE (see storedDeflate above), so it is a valid
// method-8 entry with no compressor: what this exercises is the inflate PATH, not
// a Huffman table.
inline std::string withDeflatedCoverImage(const std::string& bytes) {
  return detail::assemble("<meta name=\"cover\" content=\"cover-img\"/>",
                          detail::coverItem(""), bytes, true, true);
}

// THE CALIBRE BLOB THAT REFUSED TWO REAL BOOKS. Calibre writes one <meta> per
// custom column, each a JSON dump of that column's definition, and one of them was
// 574 decoded bytes on `Walden` and 489 on `Le soleil et l'acier` -- both from the
// same shelf, both reported as "the OPF is malformed" against Xml::kMaxAttrBytes.
//
// IT IS PLACED BEFORE THE COVER META ON PURPOSE. The blob has to be something the
// walk reads PAST rather than the last thing it reads, or the fixture cannot show
// that the OPF's own facts survive it -- which is the whole claim.
//
// The quotes are written as entities because Calibre writes them that way, and that
// is what makes the raw attribute nearly twice its decoded length.
inline std::string withCalibreUserMetadata() {
  std::string blob;
  while (blob.size() < 700) blob += "&quot;is_multiple&quot;: null, ";
  return detail::assemble(
      "<meta name=\"calibre:user_metadata:#formats\" content=\"{" + blob + "}\"/>"
      "<meta name=\"cover\" content=\"cover-img\"/>",
      detail::coverItem(""), kFakeCoverBytes, true);
}

}  // namespace epubbuild
