// RE-ESTABLISHING THE STREAM A QUIET-WINDOW WALK SPENT.
//
// Three things rewind the ChapterReader the live PageBuilder reads from, and all
// three therefore have to drop that builder before they walk: completeIndex,
// warmPageRing, and seekTo itself. None of them could put it back, so the next
// FORWARD turn paid a full seekTo -- ~376 ms on the device at page 38 and ~1010 ms
// at page 99, against ~20 ms with the stream standing.
//
// This file pins the entry point that puts it back, and the property that makes
// running it safe: it changes NOTHING the user can see, on every path including the
// abandoned one.
#include <cstdint>
#include <memory>
#include <string>
#include <vector>

#include "doctest.h"
#include "fake_fs.h"
#include "ramp.h"
#include "reader_fixture.h"
#include "reader/book.h"
#include "reader/reading_store.h"
#include "reader/screen_reader.h"
#include "reader/theme_quiet.h"

using reader::Gesture;

namespace {

// Where a reader actually is when this matters: several pages into a chapter whose
// count was deferred, which is 37% of a real book's chapters.
readerfix::Reading* deferredAtPage(std::unique_ptr<readerfix::Reading>& hold, int page) {
  hold = std::make_unique<readerfix::Reading>(readerfix::deferredChapter(), /*settled=*/false);
  for (int i = 0; i < page; ++i) hold->scr->onGesture({Gesture::Next});
  REQUIRE(hold->scr->pageIndex() == page);
  return hold.get();
}

// --- A CARD-BACKED BOOK, BECAUSE AN IN-MEMORY ONE CANNOT ANSWER THE QUESTION ---
//
// `ChapterReader::bytesRead()` is `inflated_ != nullptr ? inflater_.produced() : 0`,
// and the in-memory constructor readerfix::Reading uses has no inflater -- so it
// reports 0 forever. An invisibility assertion on `chapterBytesRead()` over that
// fixture is `0 == 0`: it passes with the walk clobbering the field, which is how
// this was found (a mutation that should have bitten and did not).
//
// The byte count is the ONE field here worth that trouble, because the reading
// percentage is made of it: a drift is not a wrong pixel, it is a saved position
// that lies about where the reader was.
//
// So this builds a real EPUB in memory. The one thing that makes it cheap is that
// DEFLATE has a STORED BLOCK MODE -- BTYPE=00, a 5-byte header and the bytes -- so
// a valid method-8 entry needs no compressor, only a framer. The inflater takes the
// same path it takes for a real book (`inflate_stream.cpp` validates the NLEN
// complement, so a mis-framed block would fail loudly rather than silently).
//
// Not added to test/unit/epub_fixtures.h, which is generated by tools/mkzip.py and
// shared: this is one test file's need, and the fixture header is a checked-in
// generated artefact.

void put16(std::string& s, uint16_t v) {
  s += static_cast<char>(v & 0xFF);
  s += static_cast<char>((v >> 8) & 0xFF);
}
void put32(std::string& s, uint32_t v) {
  for (int i = 0; i < 4; ++i) s += static_cast<char>((v >> (8 * i)) & 0xFF);
}

// Raw DEFLATE (no zlib wrapper -- the zip's csize/usize carry the framing) made
// entirely of stored blocks. Valid DEFLATE that any inflater must accept.
std::string storedDeflate(const std::string& data) {
  std::string out;
  size_t at = 0;
  do {
    const size_t n = data.size() - at > 65535 ? 65535 : data.size() - at;
    const bool last = at + n >= data.size();
    out += static_cast<char>(last ? 1 : 0);  // BFINAL, BTYPE=00, then byte-aligned
    put16(out, static_cast<uint16_t>(n));
    put16(out, static_cast<uint16_t>(~static_cast<uint16_t>(n)));
    out.append(data, at, n);
    at += n;
  } while (at < data.size());
  return out;
}

struct ZipEntry {
  std::string name;
  std::string data;
  bool deflate = true;
};

// zip.cpp trusts the CENTRAL directory and validates no CRC, so the field is zero.
std::string buildZip(const std::vector<ZipEntry>& entries) {
  std::string out, central;
  for (const ZipEntry& e : entries) {
    const std::string raw = e.deflate ? storedDeflate(e.data) : e.data;
    const uint32_t off = static_cast<uint32_t>(out.size());
    put32(out, 0x04034B50);
    put16(out, 20);
    put16(out, 0);
    put16(out, e.deflate ? 8 : 0);
    put16(out, 0);
    put16(out, 0);
    put32(out, 0);  // crc32 -- not validated, see above
    put32(out, static_cast<uint32_t>(raw.size()));
    put32(out, static_cast<uint32_t>(e.data.size()));
    put16(out, static_cast<uint16_t>(e.name.size()));
    put16(out, 0);
    out += e.name;
    out += raw;

    put32(central, 0x02014B50);
    put16(central, 20);
    put16(central, 20);
    put16(central, 0);
    put16(central, e.deflate ? 8 : 0);
    put16(central, 0);
    put16(central, 0);
    put32(central, 0);
    put32(central, static_cast<uint32_t>(raw.size()));
    put32(central, static_cast<uint32_t>(e.data.size()));
    put16(central, static_cast<uint16_t>(e.name.size()));
    put16(central, 0);
    put16(central, 0);
    put16(central, 0);
    put16(central, 0);
    put32(central, 0);
    put32(central, off);
    central += e.name;
  }
  const uint32_t cdOff = static_cast<uint32_t>(out.size());
  out += central;
  put32(out, 0x06054B50);
  put16(out, 0);
  put16(out, 0);
  put16(out, static_cast<uint16_t>(entries.size()));
  put16(out, static_cast<uint16_t>(entries.size()));
  put32(out, static_cast<uint32_t>(central.size()));
  put32(out, cdOff);
  put16(out, 0);
  return out;
}

std::string epubWith(const std::string& ch1) {
  const std::string container =
      "<?xml version=\"1.0\"?>"
      "<container version=\"1.0\" "
      "xmlns=\"urn:oasis:names:tc:opendocument:xmlns:container\">"
      "<rootfiles><rootfile full-path=\"OEBPS/content.opf\" "
      "media-type=\"application/oebps-package+xml\"/></rootfiles></container>";
  const std::string opf =
      "<?xml version=\"1.0\"?>"
      "<package xmlns=\"http://www.idpf.org/2007/opf\" version=\"3.0\" "
      "unique-identifier=\"bookid\">"
      "<metadata xmlns:dc=\"http://purl.org/dc/elements/1.1/\">"
      "<dc:identifier id=\"bookid\">urn:uuid:0000-1111</dc:identifier>"
      "<dc:title>Middlemarch</dc:title><dc:creator>George Eliot</dc:creator>"
      "<dc:language>en</dc:language></metadata>"
      "<manifest>"
      "<item id=\"ch1\" href=\"ch1.xhtml\" media-type=\"application/xhtml+xml\"/>"
      "<item id=\"ch2\" href=\"ch2.xhtml\" media-type=\"application/xhtml+xml\"/>"
      "</manifest>"
      "<spine><itemref idref=\"ch1\"/><itemref idref=\"ch2\"/></spine></package>";
  return buildZip({
      {"mimetype", "application/epub+zip", false},
      {"META-INF/container.xml", container, true},
      {"OEBPS/content.opf", opf, true},
      {"OEBPS/ch1.xhtml", ch1, true},
      {"OEBPS/ch2.xhtml", "<html><body><p>Two.</p></body></html>", true},
  });
}

// The card-backed equivalent of readerfix::Reading. Held together because a
// ScalableFont borrows its bytes and a ReaderScreen borrows the FileSystem.
struct CardReading {
  ramp::Ramp ramp;
  reader::QuietTheme theme;
  readerfix::Body body;
  reader::PageMetrics m;
  FakeFileSystem fs;
  reader::OpenedBook ob;
  std::unique_ptr<reader::ReaderScreen> scr;

  explicit CardReading(const std::string& ch1) {
    theme.readerMetrics(480, 800, ramp.fonts, body.face, m);
    REQUIRE(fs.writeAll("/books/b.epub", epubWith(ch1)));
    const char* why = "";
    REQUIRE_MESSAGE(reader::openBook(fs, "/books/b.epub", ob, &why), std::string(why));
    scr = std::make_unique<reader::ReaderScreen>(fs, ob, 0, &body.face);
    scr->setMetrics(m);
  }
};

}  // namespace

// --- WHAT SPENDS THE STREAM ---------------------------------------------------

TEST_CASE("a completed page count spends the stream, not only an abandoned one") {
  // THE CLAIM THIS FILE EXISTS TO CORRECT. kCountQuietMs's comment said a count that
  // completes "leaves a live builder behind it" and used that to argue for the long
  // window. It does not: completeIndex ends in seekTo(at_), `at_` is by definition
  // the page the ring is most certain to hold, so the restore leg takes the cache
  // hit -- and a hit deliberately leaves `pb_` null, because nothing was decoded.
  //
  // So the cost the long window was protecting against is paid on the COMMON path
  // too, every time a big chapter's count lands.
  std::unique_ptr<readerfix::Reading> hold;
  readerfix::Reading* r = deferredAtPage(hold, 5);
  REQUIRE(r->scr->indexPending());
  REQUIRE(r->scr->hasLiveStream());

  REQUIRE(r->scr->completeIndex());  // completes -- not abandoned
  CHECK_FALSE(r->scr->hasLiveStream());
}

TEST_CASE("an abandoned page count spends the stream") {
  std::unique_ptr<readerfix::Reading> hold;
  readerfix::Reading* r = deferredAtPage(hold, 5);
  REQUIRE(r->scr->indexPending());
  REQUIRE(r->scr->hasLiveStream());

  CHECK_FALSE(r->scr->completeIndex([](void*) { return true; }, nullptr));
  CHECK_FALSE(r->scr->hasLiveStream());
}

TEST_CASE("a spent stream makes the next forward turn decode") {
  // The user-visible half of the two above: this decode is the ~376 ms.
  std::unique_ptr<readerfix::Reading> hold;
  readerfix::Reading* r = deferredAtPage(hold, 5);
  REQUIRE(r->scr->completeIndex());
  const uint32_t decodes = r->scr->ringStats().decodes;

  r->scr->onGesture({Gesture::Next});
  CHECK(r->scr->ringStats().decodes == decodes + 1);
}

// --- PUTTING IT BACK ----------------------------------------------------------

TEST_CASE("a restream changes nothing the user can see") {
  // THE PROPERTY EVERYTHING ELSE HERE RESTS ON, and it is asserted first for the
  // reason warmPageRing's equivalent is: this rewinds the stream mid-book, so if it
  // disturbed the page, the position or the byte count it would be a screen that
  // changed by itself while being read -- and the byte count is what the reading
  // percentage is made of, so a drift there is a saved position that lies.
  std::unique_ptr<readerfix::Reading> hold;
  readerfix::Reading* r = deferredAtPage(hold, 6);
  REQUIRE(r->scr->completeIndex());
  REQUIRE_FALSE(r->scr->hasLiveStream());

  const int wasPage = r->scr->pageIndex();
  const int wasCount = r->scr->pageCount();
  const bool wasPending = r->scr->indexPending();
  const std::string wasText = readerfix::pageText(r->scr->page());
  const reader::Cursor wasCursor = r->scr->currentCursor();
  const int wasVmPage = r->scr->vm().page;
  const int wasVmTotal = r->scr->vm().pageTotal;

  REQUIRE(r->scr->restreamAtCurrentPage());

  CHECK(r->scr->pageIndex() == wasPage);
  CHECK(r->scr->pageCount() == wasCount);
  CHECK(r->scr->indexPending() == wasPending);
  CHECK(readerfix::pageText(r->scr->page()) == wasText);
  CHECK(r->scr->currentCursor() == wasCursor);
  CHECK(r->scr->vm().page == wasVmPage);
  CHECK(r->scr->vm().pageTotal == wasVmTotal);
  // ...and the thing it was for.
  CHECK(r->scr->hasLiveStream());
  // The byte count is deliberately NOT asserted here -- see the card-backed case
  // at the bottom of this file. This fixture's chapter is in memory, so
  // chapterBytesRead() is 0 whatever the walk does to it.
}

TEST_CASE("a restream over a real archive leaves the byte count exactly where it was") {
  // THE ASSERTION THE IN-MEMORY FIXTURE CANNOT MAKE, and the one that matters most:
  // `chapterBytesRead()` is what the reading percentage is made of, so a restream
  // that moved it would not show as a wrong pixel -- it would show as a saved
  // position that lies, and this project has already shipped a percentage that went
  // BACKWARDS for a neighbouring reason.
  CardReading r(readerfix::deferredChapter());
  for (int i = 0; i < 4; ++i) r.scr->onGesture({Gesture::Next});
  REQUIRE(r.scr->pageIndex() == 4);
  REQUIRE(r.scr->completeIndex());
  REQUIRE_FALSE(r.scr->hasLiveStream());

  const uint32_t wasBytes = r.scr->chapterBytesRead();
  // THE FIXTURE IS ONLY USEFUL IF THIS IS NON-ZERO. A stored entry or an in-memory
  // chapter reports 0, and every assertion below would then be trivially true --
  // which is exactly the hole this test was written to close.
  REQUIRE(wasBytes > 0);
  const int wasPage = r.scr->pageIndex();
  const std::string wasText = readerfix::pageText(r.scr->page());

  REQUIRE(r.scr->restreamAtCurrentPage());
  CHECK(r.scr->chapterBytesRead() == wasBytes);
  CHECK(r.scr->pageIndex() == wasPage);
  CHECK(readerfix::pageText(r.scr->page()) == wasText);
  CHECK(r.scr->hasLiveStream());
}

TEST_CASE("an abandoned restream over a real archive leaves the byte count alone too") {
  CardReading r(readerfix::deferredChapter());
  for (int i = 0; i < 4; ++i) r.scr->onGesture({Gesture::Next});
  REQUIRE(r.scr->completeIndex());
  const uint32_t wasBytes = r.scr->chapterBytesRead();
  REQUIRE(wasBytes > 0);
  const int wasPage = r.scr->pageIndex();
  const std::string wasText = readerfix::pageText(r.scr->page());

  CHECK_FALSE(r.scr->restreamAtCurrentPage([](void*) { return true; }, nullptr));
  CHECK(r.scr->chapterBytesRead() == wasBytes);
  CHECK(r.scr->pageIndex() == wasPage);
  CHECK(readerfix::pageText(r.scr->page()) == wasText);
}

TEST_CASE("WHEN the count lands cannot change the percentage a save would take") {
  // THE QUESTION SHORTENING kCountQuietMs HAS TO ANSWER, and the reason it can be
  // shortened at all.
  //
  // This project shipped a reading percentage that went BACKWARDS, and the recorded
  // cause was that progressPercent interpolated on page/pageTotal -- which is 0
  // until the deferred count lands -- so a save taken in that window persisted an
  // un-advanced figure over a better one. Widening kCountQuietMs from 1200 ms to
  // 5000 made it worse, because the count landed later. That is the interaction any
  // change to this constant has to be checked against.
  //
  // It cannot come back for a real chapter, and this is the proof rather than the
  // claim: the percentage is made of BYTES now (reading_store.cpp prefers
  // bytesIntoChapter and reads page/pageTotal only when it is zero), and every
  // chapter of every real EPUB is deflated, so the bytes are always there. The two
  // readings below straddle the count landing and must be equal.
  CardReading r(readerfix::deferredChapter());
  for (int i = 0; i < 4; ++i) r.scr->onGesture({Gesture::Next});
  REQUIRE(r.scr->indexPending());
  REQUIRE(r.scr->vm().pageTotal == 0);  // the em dash the footer draws
  REQUIRE(r.scr->chapterBytesRead() > 0);

  const int spine = r.scr->chapterIndex();
  const int before = reader::progressPercent(r.ob, spine, r.scr->vm().page,
                                             r.scr->vm().pageTotal, r.scr->chapterBytesRead());

  REQUIRE(r.scr->completeIndex());
  REQUIRE(r.scr->vm().pageTotal > 0);  // the total has landed
  const int after = reader::progressPercent(r.ob, spine, r.scr->vm().page,
                                            r.scr->vm().pageTotal, r.scr->chapterBytesRead());
  CHECK(before == after);

  // ...and the restream does not move it either, which is the new code's own half
  // of the same question.
  REQUIRE(r.scr->restreamAtCurrentPage());
  CHECK(reader::progressPercent(r.ob, spine, r.scr->vm().page, r.scr->vm().pageTotal,
                                r.scr->chapterBytesRead()) == before);
}

TEST_CASE("a card-backed restream makes the next forward turn free") {
  // The prize on the path the DEVICE takes: a real inflater over a real archive,
  // which is the one the in-memory fixture cannot exercise at all.
  CardReading r(readerfix::deferredChapter());
  for (int i = 0; i < 4; ++i) r.scr->onGesture({Gesture::Next});
  REQUIRE(r.scr->completeIndex());
  REQUIRE(r.scr->restreamAtCurrentPage());

  const uint32_t decodes = r.scr->ringStats().decodes;
  const int was = r.scr->pageIndex();
  r.scr->onGesture({Gesture::Next});
  CHECK(r.scr->pageIndex() == was + 1);
  CHECK(r.scr->ringStats().decodes == decodes);
  // ...and the percentage's input advanced with the page, which is the whole reason
  // the byte count exists.
  CHECK(r.scr->chapterBytesRead() > 0);
}

TEST_CASE("an abandoned restream changes nothing the user can see either") {
  // AND IT HAD NOTHING TO SPEND, which is the whole difference from completeIndex
  // and warmPageRing: those two drop a LIVE builder before they walk, so abandoning
  // costs the next forward turn. This one runs only when the builder is already
  // null, so an abandon leaves exactly the state it found.
  std::unique_ptr<readerfix::Reading> hold;
  readerfix::Reading* r = deferredAtPage(hold, 6);
  REQUIRE(r->scr->completeIndex());
  REQUIRE_FALSE(r->scr->hasLiveStream());

  const int wasPage = r->scr->pageIndex();
  const int wasCount = r->scr->pageCount();
  const std::string wasText = readerfix::pageText(r->scr->page());
  const reader::Cursor wasCursor = r->scr->currentCursor();

  CHECK_FALSE(r->scr->restreamAtCurrentPage([](void*) { return true; }, nullptr));

  CHECK(r->scr->pageIndex() == wasPage);
  CHECK(r->scr->pageCount() == wasCount);
  CHECK(readerfix::pageText(r->scr->page()) == wasText);
  CHECK(r->scr->currentCursor() == wasCursor);
  // Still no stream -- it could not finish -- so the reader is exactly where an
  // abandoned count left it and the next forward turn pays what it pays today.
  CHECK_FALSE(r->scr->hasLiveStream());
  // And both directions still work, which is what makes an abandoned restream
  // merely wasted rather than damaging.
  r->scr->onGesture({Gesture::Next});
  CHECK(r->scr->pageIndex() == wasPage + 1);
  r->scr->onGesture({Gesture::Prev});
  CHECK(r->scr->pageIndex() == wasPage);
  CHECK(readerfix::pageText(r->scr->page()) == wasText);
}

TEST_CASE("a restream makes the next forward turn free") {
  // The prize, stated as the decode counter rather than as the page: both walks
  // produce the right page, and a green suite could not tell them apart.
  std::unique_ptr<readerfix::Reading> hold;
  readerfix::Reading* r = deferredAtPage(hold, 6);
  REQUIRE(r->scr->completeIndex());
  REQUIRE(r->scr->restreamAtCurrentPage());

  const uint32_t decodes = r->scr->ringStats().decodes;
  const int was = r->scr->pageIndex();
  r->scr->onGesture({Gesture::Next});
  CHECK(r->scr->pageIndex() == was + 1);
  CHECK(r->scr->ringStats().decodes == decodes);  // the turn touched no card
}

TEST_CASE("a restream with the stream already standing does nothing at all") {
  // A LIVE BUILDER BEATS RE-ESTABLISHING ONE, ~20 ms against ~376. Without this gate
  // the quiet window would rewind the stream it is supposed to be protecting -- the
  // exact defect warmPageRing's headroom gate exists to prevent, one door along.
  std::unique_ptr<readerfix::Reading> hold;
  readerfix::Reading* r = deferredAtPage(hold, 5);
  REQUIRE(r->scr->hasLiveStream());
  const uint32_t decodes = r->scr->ringStats().decodes;

  CHECK_FALSE(r->scr->restreamAtCurrentPage());
  CHECK(r->scr->ringStats().decodes == decodes);
  CHECK(r->scr->hasLiveStream());
}

TEST_CASE("a restream on page one is legal and is the cheapest one") {
  // warmPageRing refuses page 0 -- there is nothing behind it to cache -- but a
  // restream there is both valid and the cheapest walk there is, so the two gates
  // are deliberately different.
  std::unique_ptr<readerfix::Reading> hold;
  readerfix::Reading* r = deferredAtPage(hold, 3);
  REQUIRE(r->scr->completeIndex());
  for (int i = 0; i < 3; ++i) r->scr->onGesture({Gesture::Prev});
  REQUIRE(r->scr->pageIndex() == 0);

  const std::string wasText = readerfix::pageText(r->scr->page());
  if (!r->scr->hasLiveStream()) REQUIRE(r->scr->restreamAtCurrentPage());
  CHECK(r->scr->hasLiveStream());
  CHECK(r->scr->pageIndex() == 0);
  CHECK(readerfix::pageText(r->scr->page()) == wasText);
}

// --- THE PAGES IT PASSES ARE KEPT ---------------------------------------------

TEST_CASE("a restream fills the ring on its way, so it warms too") {
  // It walks the same prefix warmPageRing walks -- they are ONE walk with two gates
  // -- so a restream that lands leaves the backward headroom a warm would have left.
  // That is why the shell runs this first: a completed restream usually makes the
  // warm below it a no-op.
  std::unique_ptr<readerfix::Reading> hold;
  readerfix::Reading* r = deferredAtPage(hold, 8);
  r->scr->setPageCacheDepth(4);
  REQUIRE(r->scr->completeIndex());
  // completeIndex's restore leg re-seeds only the page it landed on, and the count
  // walk before it evicted the rest.
  REQUIRE(r->scr->restreamAtCurrentPage());
  CHECK(r->scr->backwardHeadroom() >= r->scr->pageCacheDepth() - 1);
  CHECK_FALSE(r->scr->warmPageRing());  // nothing left for it to do
}

// --- READING BACKWARD STILL GIVES EXACTLY THE PAGES READING FORWARD GAVE ------

TEST_CASE("a restream between every turn does not change what any page says") {
  // The strongest property in this area, run with a restream interleaved: if the
  // re-established builder were positioned even one page off, the forward halves of
  // this walk would disagree with the reference.
  //
  // WALKED BACK TWICE THE RING'S DEPTH, because a forward read already seeds the
  // ring with the last kPageCacheDepth pages -- a shorter walk back is served
  // entirely from that and cannot see a paging change at all.
  const std::string doc = readerfix::longChapter(60);
  readerfix::Reading fwd(doc);
  std::vector<std::string> text;
  for (;;) {
    text.push_back(readerfix::pageText(fwd.scr->page()));
    const int was = fwd.scr->pageIndex();
    fwd.scr->onGesture({Gesture::Next});
    if (fwd.scr->pageIndex() == was) break;
  }
  const int depth = 3;
  REQUIRE(static_cast<int>(text.size()) > depth * 3);

  readerfix::Reading r(doc);
  r.scr->setPageCacheDepth(depth);
  const int last = static_cast<int>(text.size()) - 1;
  for (int i = 0; i < last; ++i) r.scr->onGesture({Gesture::Next});

  for (int i = 0; i < depth * 2; ++i) {
    r.scr->onGesture({Gesture::Prev});
    r.scr->restreamAtCurrentPage();  // the idle window, between every turn
    const int want = last - 1 - i;
    CHECK(r.scr->pageIndex() == want);
    CHECK(readerfix::pageText(r.scr->page()) == text[static_cast<size_t>(want)]);
  }
  // ...and forward again over the same ground, which is what a mispositioned
  // builder would corrupt.
  for (int i = 0; i < depth * 2; ++i) {
    r.scr->onGesture({Gesture::Next});
    r.scr->restreamAtCurrentPage();
    const int want = last - depth * 2 + 1 + i;
    CHECK(r.scr->pageIndex() == want);
    CHECK(readerfix::pageText(r.scr->page()) == text[static_cast<size_t>(want)]);
  }
}
